## drivers/bmx160/Kconfig
```kconfig
# Copyright (c) 2020 HAW Hamburg
#
# This file is subject to the terms and conditions of the GNU Lesser
# General Public License v2.1. See the file LICENSE in the top level
# directory for more details.
#

menuconfig MODULE_BMX160
    bool
    prompt "BMx160 Temperature, pressure and humidity sensors" if !(MODULE_SAUL_DEFAULT && HAVE_BMX160)
    default (MODULE_SAUL_DEFAULT && HAVE_BMX160)
    depends on TEST_KCONFIG

if MODULE_BMX160

choice BMX160_VARIANT
    bool "Model"
    default MODULE_BME160_I2C if HAVE_BME160_I2C
    default MODULE_BME160_SPI if HAVE_BME160_SPI
    default MODULE_BMP160_I2C if HAVE_BMP160_I2C
    default MODULE_BMP160_SPI if HAVE_BMP160_SPI
    help
        The driver supports both BME160 and BMP160 connected either via SPI or
        I2C bus. Select one combination.

config MODULE_BME160_I2C
    bool "BME160 on I2C"
    depends on HAS_PERIPH_I2C
    select MODULE_PERIPH_I2C

config MODULE_BME160_SPI
    bool "BME160 on SPI"
    depends on HAS_PERIPH_SPI
    depends on HAS_PERIPH_GPIO
    select MODULE_PERIPH_SPI
    select MODULE_PERIPH_GPIO

config MODULE_BMP160_I2C
    bool "BMP160 on I2C"
    depends on HAS_PERIPH_I2C
    select MODULE_PERIPH_I2C

config MODULE_BMP160_SPI
    bool "BMP160 on SPI"
    depends on HAS_PERIPH_SPI
    depends on HAS_PERIPH_GPIO
    select MODULE_PERIPH_SPI
    select MODULE_PERIPH_GPIO

endchoice

endif # MODULE_BMX160

config HAVE_BMX160
    bool
    help
        Indicates that a bmx160 sensor is present.

config HAVE_BME160_I2C
    bool
    select HAVE_BMX160
    help
      Indicates that a bme160 sensor on the I2C bus is present.

config HAVE_BME160_SPI
    bool
    select HAVE_BMX160
    help
      Indicates that a bme160 sensor on the SPI bus is present.

config HAVE_BMP160_I2C
    bool
    select HAVE_BMX160
    help
      Indicates that a bmp160 sensor on the I2C bus is present.

config HAVE_BMP160_SPI
    bool
    select HAVE_BMX160
    help
      Indicates that a bmp160 sensor on the SPI bus is present.
```
